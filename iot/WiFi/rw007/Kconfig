## iot/WiFi/rw007/Kconfig
```kconfig
menuconfig PKG_USING_RW007
    bool "rw007: SPI WIFI rw007 driver"
    select RT_USING_SPI
    select RT_USING_PIN
    select RT_USING_LWIP
    default n
    help
        if "PKG_USING_RW007" is opened, "RT_USING_LWIP" will be default selected.

if PKG_USING_RW007

    config PKG_RW007_PATH
        string
        default "/packages/iot/WiFi/rw007"

    choice
        prompt "version"
        help
            Select the wiced wifi version
	    default PKG_USING_RW007_V210

        config PKG_USING_RW007_V200
            bool "v2.0.0"

        config PKG_USING_RW007_V201
            bool "v2.0.1"

        config PKG_USING_RW007_V210
            bool "v2.1.0"

        config PKG_USING_RW007_LATEST_VERSION
            bool "latest"
    endchoice

    config PKG_RW007_VER
        string
        default "v2.0.0" if PKG_USING_RW007_V200
        default "v2.0.1" if PKG_USING_RW007_V201
        default "v2.1.0" if PKG_USING_RW007_V210
        default "latest" if PKG_USING_RW007_LATEST_VERSION

    if PKG_USING_RW007_V210
        config RW007_USING_BLE
            bool "use ble function"
    endif

    config RW007_SPI_MAX_HZ
        int "SPI Max Hz"
        default 30000000
	
	config RW007_SPI_BUS_NAME
		string "RW007 BUS NAME"
		default "spi2"

	config RW007_CS_PIN
		int "CS pin index"
		default 102

	config RW007_INT_BUSY_PIN
		int "INT/BUSY pin index"
		default 62

	config RW007_RST_PIN
		int "RESET pin index"
		default 187

    config RW007_USING_STM32_DRIVERS
        bool "exampler driver: rw007 for stm32"

    config RW007_USING_SPI_TEST
        bool "test: spi throughput capability and packet loss testing"
    
    config RW007_USING_POWERSWITCH_EXAMPLE
    	bool "example: save power by switching"

endif
```
